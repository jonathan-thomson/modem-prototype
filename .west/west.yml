## .west/west.yml
```yaml
manifest:
  self:
    west-commands: west-commands.yml

  remotes:
    - name: jonathan-thomson
      url-base: https://github.com/jonathan-thomson

  projects:
    - name: zephyr
      remote: jonathan-thomson
      repo-path: zephyr.git
      revision: e72fd66378ccdef18ca864c7bc23a88604f695ed
      import:
        path-prefix: thirdparty/zephyrproject
        name-allowlist:
          - cmsis_6
          - hal_nxp
          - picolibc
          - segger
```

## targets/boards/jt/control/Kconfig.defconfig
```kconfig
# Copyright (c) 2017, NXP
# SPDX-License-Identifier: Apache-2.0

if BOARD_MIMXRT1050_CONTROL || BOARD_REVISION_A4

config BOARD
    default "mimxrt1050_jt_control" if BOARD_MIMXRT1050_CONTROL
    default "mimxrt1050_jt_control_a4" if BOARD_REVISION_A4

config FW_CONTROL
    bool "control firmware"
    default true
    help
    Hints that the Firmware is for control MCU

config EARLY_INIT
    bool "Enables early init"
    default true
    help
      Used as a guard to enable running of routines that should occur before default Zephyr initialisation.
      i.e. FlexRAM reconfiguration.

endif # BOARD_MIMXRT1050_CONTROL || BOARD_REVISION_A4
```

## targets/boards/jt/control/board.yml
```yaml
board:
  name: control
  vendor: jt
  revision:
    format: custom
    revisions:
      - name: a4
  socs:
    - name: mimxrt1052
```

## targets/boards/shields/sense/Kconfig.shield
```kconfig
config SHIELD_SENSE
    def_bool $(shields_list_contains,sense)

config SHIELD_SENSE_A3
    def_bool $(shields_list_contains,sense_a2)
```
